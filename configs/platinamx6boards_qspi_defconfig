## configs/platinamx6boards_qspi_defconfig
```kconfig
CONFIG_ARM=y
CONFIG_ARCH_MX6=y
CONFIG_SYS_TEXT_BASE=0x90000000
CONFIG_TARGET_PLATINAMX6BOARDS=y
CONFIG_NR_DRAM_BANKS=1
CONFIG_FIT=y
CONFIG_FIT_VERBOSE=y
CONFIG_SYS_EXTRA_OPTIONS="IMX_CONFIG=board/platina/mx6boards/imximage.cfg,MX6SX,I2C_PMIC_0,SYS_BOOT_QSPI"
CONFIG_BOOTSTAGE_STASH_SIZE=4096
CONFIG_CMD_BOOTZ=y
# CONFIG_CMD_FLASH is not set
CONFIG_CMD_MTD=y
# CONFIG_CMD_SETEXPR is not set
CONFIG_CMD_MTDPARTS=y
CONFIG_MTDIDS_DEFAULT="nor0=021e0000.qspi"
CONFIG_MTDPARTS_DEFAULT="021e0000.qspi:512k(uboot),256k(dtb),256k(env),8m(itb),0x00680000(ubi)"
CONFIG_CMD_UBI=y
# CONFIG_CMD_UBIFS is not set
CONFIG_OF_CONTROL=y
CONFIG_DEFAULT_DEVICE_TREE="platina-mk1-bmc"
CONFIG_ENV_IS_IN_SPI_FLASH=y
CONFIG_MTD=y
CONFIG_DM_SPI_FLASH=y
CONFIG_SPI_FLASH=y
CONFIG_SPI_FLASH_BAR=y
CONFIG_SPI_FLASH_MACRONIX=y
CONFIG_SPI_FLASH_SPANSION=y
CONFIG_SPI_FLASH_STMICRO=y
CONFIG_SPI_FLASH_MTD=y
CONFIG_SPI=y
CONFIG_DM_SPI=y
CONFIG_FSL_QSPI=y
# CONFIG_USE_PRIVATE_LIBGCC is not set
```
